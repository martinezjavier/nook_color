## cyttsp/Kconfig
```kconfig
config TOUCHSCREEN_CYTTSP_CORE
	tristate "Cypress TTSP touchscreen"
	help
         Say Y here if you have a touchscreen using controller from
         the Cypress TrueTouch(tm) Standard Product family connected
         to your system. You will also need to select appropriate
         bus connection below.

	 If unsure, say N.

	  To compile this driver as a module, choose M here: the
	  module will be called cyttsp_core.

config TOUCHSCREEN_CYTTSP_I2C
        tristate "support I2C bus connection"
        depends on TOUCHSCREEN_CYTTSP_CORE && I2C
	help
	Say Y here if the touchscreen is connected via I2C bus.

	 To compile this driver as a module, choose M here: the
	 module will be called cyttsp_i2c.

config TOUCHSCREEN_CYTTSP_SPI
        tristate "support SPI bus connection"
        depends on TOUCHSCREEN_CYTTSP_CORE && SPI_MASTER
	help
	Say Y here if the touchscreen is connected via SPI bus.

	 To compile this driver as a module, choose M here: the
	 module will be called cyttsp_spi.
```

## cyttsp_android_v2.6.32.9/Kconfig
```kconfig
config TOUCHSCREEN_CYTTSP_CORE
	tristate "Cypress TTSP touchscreen core"
	help
	  Always activated for Cypress TTSP touchscreen

config TOUCHSCREEN_CYTTSP_I2C
	tristate "Cypress TTSP i2c touchscreen"
	depends on I2C && TOUCHSCREEN_CYTTSP_CORE
	help
	  Say Y here if you have a Cypress TTSP touchscreen
	  connected to your system with an I2C interface.

	  If unsure, say N.

	  To compile this driver as a module, choose M here: the
	  module will be called cyttsp-i2c.

config TOUCHSCREEN_CYTTSP_SPI
	tristate "Cypress TTSP spi touchscreen"
	depends on SPI_MASTER && TOUCHSCREEN_CYTTSP_CORE
	help
	  Say Y here if you have a Cypress TTSP touchscreen
	  connected to your  with an SPI interface.

	  If unsure, say N.

	  To compile this driver as a module, choose M here: the
	  module will be called cyttsp-spi.
```
